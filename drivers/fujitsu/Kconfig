## drivers/fujitsu/Kconfig
```kconfig
menuconfig FUJITSU_ORG_DRIVER
	bool "Fujitsu device drivers"
	default y
	---help---
	  Say Y here to get to see options for device drivers from various
	  different categories. This option alone does not add any kernel code.

	  If you say N, all options in this submenu will be skipped and disabled.

source "drivers/fujitsu/compass/Kconfig"
source "drivers/fujitsu/keypad/Kconfig"
source "drivers/fujitsu/proximity/Kconfig"
source "drivers/fujitsu/walkmotion/Kconfig"
```

## drivers/fujitsu/keypad/Kconfig
```kconfig
config FUJITSU_KEYPAD
	bool "Fujitsu HW Key Devices driver"
	default y
	---help---
	  Say Y here if you want to enable the driver for the FUJITSU's keypad.
	  This is intended to support it's hard key.

	  To compile this driver as a module, choose M here: the module will
	  be called keypad.
```

## drivers/fujitsu/proximity/Kconfig
```kconfig
config FUJITSU_PROXIMITY_DRIVER
	bool "Fujitsu Proximity sensor Devices driver"
	default y
	---help---
	  If you say yes here you get support for the Proximity sensor
	  chips.

	  This driver can also be built as a module. If so, the module
	  will be called proximity sensor.

config FUJITSU_ILLUMI_DRIVER
	bool "Fujitsu Illuminance sensor Devices driver"
	depends on FUJITSU_PROXIMITY_DRIVER
	default y
	---help---
	  If you say yes here you get support for the Illuminance
	  sensor chips.

	  This driver can also be built as a module. If so, the module
	  will be called proximity sensor.
```

## drivers/fujitsu/walkmotion/Kconfig
```kconfig
config FUJITSU_WALKMOTION
	tristate "WalkMotion driver support"
	default y
	help
	  Say Y here to enable based walkMotion support.
```

## drivers/tspdrv/Kconfig
```kconfig
#
# TouchSense configuration
#

menuconfig TSPDRV
# 2012.06.07 chg[start]
	bool "TouchSense support"
#	tristate "TouchSense support"
#       default m
	default y
# 2012.06.07 chg[end]
	---help---
	  This is TouchSense Kconfig.
```
